/*
 * polari_graph.c: the glue — main() as a scheduler over the graph's edges, calling the atoms by name — GENERATED by cmod.custom.glue 1 from the no-code graph uno-sim-rig-graph (sha256 e5ea718e89a45da51a08875efccced559a04f2e1640d8aad53cf77aa186b89b4).
 * Regenerate with `pol cmod render uno-sim-rig-graph`. Editing by hand is allowed: `pol cmod diff uno-sim-rig-graph` shows it, and a render
 * never overwrites a hand edit silently. Plain C on avr-libc (RULE 2); no Python at run time.
 */
#include <stdint.h>
#include <string.h>
#include <avr/interrupt.h>

#include "board_config.h"
#include "hal.h"
#include "simrigstate_packets.h"   /* GENERATED (c_twin target=avr) */
#include "polari_graph.h"

/* the glue's state (file-scope statics, so avr-size counts them): */
static SimRigState_t state;   /* class node state: the SimRigState instance the frames carry */
static polari_rx_t rx;   /* parser node rx: the generated header's receiver */
static uint8_t frame_payload[SIMRIGSTATE_PAYLOAD_MAX];   /* frame node frame */
static uint8_t frame_wire[POLARI_HEADER_LEN + SIMRIGSTATE_PAYLOAD_MAX + 4u];

/* atom apps/sim_rig.sensor_value — copied VERBATIM from board/custom/firmware/uno/apps/sim_rig.c lines 43-55 (sha256 3c38b4bb48aad452) */
#if FEATURE_ADC
POLARI_NODE(sensor_value, in(adc, "count", "10-bit ADC reading"),
            out(return, "degC", "TMP36 temperature (or the raw count when TEMP_TMP36 is 0)"),
            role("ADC count -> the rig's temp_c (TMP36: (mV - 500) / 10)"))
static polari_avr_double_t sensor_value(uint16_t adc)
{
#if TEMP_TMP36
    /* the TMP36: mV = ADC·5000/1024 (AVcc = 5 V); °C = (mV − 500)/10 */
    polari_avr_double_t mv = (polari_avr_double_t)adc * (5000.0 / 1024.0);
    return (mv - 500.0) / 10.0;
#else
    return (polari_avr_double_t)adc;   /* raw 10-bit count, 0..1023 */
#endif
}
#endif

/* atom apps/sim_rig.apply_command — copied VERBATIM from board/custom/firmware/uno/apps/sim_rig.c lines 69-92 (sha256 3c38b4bb48aad452) */
POLARI_NODE(apply_command, in(r, "frame", "a parsed PolariPacket SimRigState command"), uses(LED_PIN, PWM_PIN),
            role("apply a command's PRESENT actuator fields (led_on, pwm_duty); status becomes commanded"))
static void apply_command(const polari_rx_t *r)
{
    SimRigState_t cmd;
    SimRigState_mask_t m;
#ifdef SIMRIGSTATE_INDEX_WIDTH
    SimRigState_index_t idx;
    if (SimRigState_decode_rx(r, &cmd, &idx, &m) != 0 || idx != INSTANCE_INDEX) return;
#else
    if (SimRigState_decode_rx(r, &cmd, &m) != 0) return;
#endif
#if FEATURE_LED
    if (m & SIMRIGSTATE_F_LED_ON) {                    /* ACTUATORS only, and only when present */
        state.led_on = cmd.led_on ? 1u : 0u;
        hal_led(state.led_on);
    }
#endif
#if FEATURE_PWM
    if (m & SIMRIGSTATE_F_PWM_DUTY) state.pwm_duty = hal_pwm_apply(cmd.pwm_duty);
#endif
    (void)m;
    state.status = SIMRIGSTATE_STATUS_COMMANDED;
}

int main(void)
{
    uint32_t frame_seq = 0u;
    uint32_t telemetry_next_ms = 0u;

    /* init: the init atoms in graph order, the class identity, then interrupts on */
    hal_usart_init();   /* usart_init */
    hal_tick_init();   /* tick_init */
    hal_led_init();   /* led_init */
    hal_pwm_init();   /* pwm_init */
    hal_adc_init();   /* adc_init */
    memset(&state, 0, sizeof state);
    memset(&rx, 0, sizeof rx);
    strcpy(state.name, RIG_NAME);
    state.status = SIMRIGSTATE_STATUS_BOOT;
    sei();

    for (;;) {
        {   /* on-rx uno-sim-rig-graph#01: rx_pop → rx; on-command (msg_type SIMRIGSTATE_MSG_TYPE): apply */
            uint8_t rx_pop_b;
            while (hal_rx_pop(&rx_pop_b))
                if (polari_rx_feed(&rx, rx_pop_b) && rx.msg_type == SIMRIGSTATE_MSG_TYPE) {
                    apply_command(&rx);   /* apply */
                }
        }
        const uint32_t clock_return = hal_millis();   /* clock */
        if ((int32_t)(clock_return - telemetry_next_ms) >= 0) {   /* tick telemetry: every TELEMETRY_MS ms */
            telemetry_next_ms += TELEMETRY_MS;
            state.uptime_ms = (int64_t)clock_return;   /* field uno-sim-rig-graph#07 */
            const uint16_t adc_return = hal_adc_read(ADC_CHANNEL);   /* adc */
            const polari_avr_double_t temp_return = sensor_value(adc_return);   /* temp */
            state.temp_c = temp_return;   /* field uno-sim-rig-graph#10 */
            if (state.status == SIMRIGSTATE_STATUS_BOOT && clock_return > 1000u) state.status = SIMRIGSTATE_STATUS_OK;   /* rule boot_ok */
            const size_t frame_length = SimRigState_frame(frame_wire, DEVICE_ID, frame_seq++, frame_payload, SimRigState_encode(&state, frame_payload, FRAME_MASK));   /* frame frame */
            hal_usart_send(frame_wire, frame_length);   /* send */
        }
    }
}
