/*
 * polari_graph.c: the glue — main() as a scheduler over the graph's edges, calling the atoms by name — GENERATED by cmod.custom.glue 1 from the no-code graph uno-light-graph (sha256 433a5765c97fd9cd3ea8d44344f755ffd562368ae8e2dd06f440faec6076e387).
 * Regenerate with `pol cmod render uno-light-graph`. Editing by hand is allowed: `pol cmod diff uno-light-graph` shows it, and a render
 * never overwrites a hand edit silently. Plain C on avr-libc (RULE 2); no Python at run time.
 */
#include <stdint.h>
#include <string.h>
#include <avr/eeprom.h>
#include <avr/interrupt.h>
#include <util/atomic.h>

#include "board_config.h"
#include "hal.h"
#include "light_defs.h"
#include "pin_config.h"
#include "lightstate_packets.h"   /* GENERATED (c_twin target=avr) */
#include "polari_graph.h"

/* the glue's state (file-scope statics, so avr-size counts them): */
static LightState_t state;   /* class node state: the LightState instance the frames carry */
static polari_rx_t rx;   /* parser node rx: the generated header's receiver */

/* atom apps/light.boot_session_mint — copied VERBATIM from board/custom/firmware/uno/apps/light.c lines 29-38 (sha256 545304a5d6e77391) */
POLARI_NODE(boot_session_mint, out(return, "", "the freshly-minted boot_session (1 on a virgin chip, else +1)"),
            role("mint this start's session number from EEPROM; it differs after every reset"))
static uint32_t boot_session_mint(void)
{
    uint32_t v = eeprom_read_dword(EEPROM_BOOT_SESSION_ADDR);
    if (v == 0xFFFFFFFFul) v = 0u;
    v++;
    eeprom_write_dword(EEPROM_BOOT_SESSION_ADDR, v);
    return v;
}

/* atom apps/light.led_toggle — copied VERBATIM from board/custom/firmware/uno/apps/light.c lines 44-54 (sha256 545304a5d6e77391) */
POLARI_NODE(led_toggle, role("on a debounced button press: flip state.led_on, count the change, source = button (the pin follows the struct: led_follow_state)"))
static void led_toggle(void)
{
#if HAL_INT0
    if (!hal_take_toggle_pending()) return;
    state.led_on = state.led_on ? 0u : 1u;
    state.toggles++;
    state.source = LIGHTSTATE_SOURCE_BUTTON;
    state.status = LIGHTSTATE_STATUS_ACTIVE;
#endif
}

/* atom apps/light.apply_command — copied VERBATIM from board/custom/firmware/uno/apps/light.c lines 57-73 (sha256 545304a5d6e77391) */
POLARI_NODE(apply_command, in(r, "frame", "a parsed PolariPacket LightState command"),
            role("SET_LED: set state.led_on from the host; a real change counts and says source = command (the pin follows the struct: led_follow_state)"))
static void apply_command(const polari_rx_t *r)
{
    LightState_t cmd;
    LightState_mask_t m;
    if (LightState_decode_rx(r, &cmd, &m) != 0) return;
    if (m & LIGHTSTATE_F_LED_ON) {
        uint8_t want = cmd.led_on ? 1u : 0u;
        if (want != state.led_on) {
            state.led_on = want;
            state.toggles++;
            state.source = LIGHTSTATE_SOURCE_COMMAND;
            state.status = LIGHTSTATE_STATUS_ACTIVE;
        }
    }
}

/* atom apps/light.led_follow_state — copied VERBATIM from board/custom/firmware/uno/apps/light.c lines 78-85 (sha256 545304a5d6e77391) */
POLARI_NODE(led_follow_state, uses(LED_PIN), role("each pass: when state.led_on differs from the value last written to the pin, drive the pin to it"))
static void led_follow_state(void)
{
    static uint8_t pin = 0u;               /* hal_led_init() leaves the pin low */
    if (state.led_on == pin) return;
    pin = state.led_on ? 1u : 0u;
    hal_led(pin);
}

/* atom apps/light.telemetry_send — copied VERBATIM from board/custom/firmware/uno/apps/light.c lines 93-99 (sha256 545304a5d6e77391) */
POLARI_NODE(telemetry_send, role("one LightState frame: the light, how often it changed, who changed it last"))
static void telemetry_send(void)
{
    state.seq = (int64_t)g_seq;
    hal_usart_send(wire, LightState_frame(wire, DEVICE_ID, g_seq, payload, TX_ENCODE(&state, payload, TELEMETRY_MASK)));
    g_seq++;
}

int main(void)
{
    uint32_t telemetry_next_ms = 0u;

    /* init: the init atoms in graph order, the class identity, then interrupts on */
    pin_config_init();   /* GENERATED (cmod.custom.pin_config_gen) — runs FIRST, before every other init (his fixed order) */
    hal_usart_init();   /* usart_init */
    hal_tick_init();   /* tick_init */
    hal_led_init();   /* led_init */
    hal_button_init();   /* button_init */
    const uint32_t boot_session_mint_return = boot_session_mint();   /* boot_session_mint */
    memset(&state, 0, sizeof state);
    memset(&rx, 0, sizeof rx);
state.boot_session = (int64_t)boot_session_mint_return;   /* field uno-light-graph#09 */
    strcpy(state.name, RIG_NAME);
    state.status = LIGHTSTATE_STATUS_IDLE;
    sei();

    for (;;) {
        {   /* on-rx uno-light-graph#01: rx_pop → rx; on-command (msg_type LIGHTSTATE_MSG_TYPE): apply */
            uint8_t rx_pop_b;
            while (hal_rx_pop(&rx_pop_b))
                if (polari_rx_feed(&rx, rx_pop_b) && rx.msg_type == LIGHTSTATE_MSG_TYPE) {
                    apply_command(&rx);   /* apply */
                }
        }
        const uint32_t clock_return = hal_millis();   /* clock */
        led_toggle();   /* led_toggle */
        led_follow_state();   /* led_follow_state */
        if ((int32_t)(clock_return - telemetry_next_ms) >= 0) {   /* tick telemetry: every TELEMETRY_MS ms */
            telemetry_next_ms += TELEMETRY_MS;
            telemetry_send();   /* telemetry_send */
        }
    }
}
