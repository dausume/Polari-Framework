/*
 * polari_graph.c: the glue — main() as a scheduler over the graph's edges, calling the atoms by name — GENERATED by cmod.custom.glue 1 from the no-code graph uno-button-clock-graph (sha256 35e45e943500ffbc1cbae25259ddce881ebd6b2c272e65b61ec35e62928d7795).
 * Regenerate with `pol cmod render uno-button-clock-graph`. Editing by hand is allowed: `pol cmod diff uno-button-clock-graph` shows it, and a render
 * never overwrites a hand edit silently. Plain C on avr-libc (RULE 2); no Python at run time.
 */
#include <stdint.h>
#include <string.h>
#include <avr/eeprom.h>
#include <avr/interrupt.h>
#include <util/atomic.h>

#include "board_config.h"
#include "button_clock_defs.h"
#include "buttonclockevent_packets.h"
#include "hal.h"
#include "pin_config.h"
#include "buttonclockstate_packets.h"   /* GENERATED (c_twin target=avr) */
#include "polari_graph.h"

/* the glue's state (file-scope statics, so avr-size counts them): */
static ButtonClockState_t state;   /* class node state: the ButtonClockState instance the frames carry */
static polari_rx_t rx;   /* parser node rx: the generated header's receiver */

/* atom apps/button_clock.l_led_init — copied VERBATIM from board/custom/firmware/uno/apps/button_clock.c lines 52-57 (sha256 5931a7efa0004dd5) */
static void l_led_init(void)
{
#ifndef POLARI_PIN_CONFIG
    L_LED_DDR |= _BV(L_LED_BIT);
#endif
}

/* atom apps/button_clock.l_led_set — copied VERBATIM from board/custom/firmware/uno/apps/button_clock.c lines 63-68 (sha256 5931a7efa0004dd5) */
POLARI_NODE(l_led_set, in(on, "bool", "0 = off, anything else = on"), uses(L_LED_PIN),
            role("mirror led_on onto the on-board L LED (D13, fixed — never a configurable knob)"))
static void l_led_set(uint8_t on)
{
    if (on) L_LED_PORT |= _BV(L_LED_BIT); else L_LED_PORT &= (uint8_t)~_BV(L_LED_BIT);
}

/* atom apps/button_clock.boot_session_mint — copied VERBATIM from board/custom/firmware/uno/apps/button_clock.c lines 75-84 (sha256 5931a7efa0004dd5) */
POLARI_NODE(boot_session_mint, out(return, "", "the freshly-minted boot_session (1 on a virgin chip, else +1)"),
            role("mint this boot's session counter from EEPROM (ucd-0e2b: wired as an init field into state.boot_session, after the class memset, before sei)"))
static uint32_t boot_session_mint(void)
{
    uint32_t v = eeprom_read_dword(EEPROM_BOOT_SESSION_ADDR);
    if (v == 0xFFFFFFFFul) v = 0u;
    v++;
    eeprom_write_dword(EEPROM_BOOT_SESSION_ADDR, v);
    return v;
}

/* atom apps/button_clock.clock_tick — copied VERBATIM from board/custom/firmware/uno/apps/button_clock.c lines 96-107 (sha256 5931a7efa0004dd5) */
POLARI_NODE(clock_tick, in(now_ms, "ms", "hal_millis() right now"), out(epoch_s, "s", "the device's current wall-clock estimate"),
            out(ms, "ms", "...within the second"),
            role("advance the wall-clock estimate = the last SET_TIME's host time + elapsed uptime since it"))
static void clock_tick(uint32_t now_ms, int64_t *epoch_s, int64_t *ms)
{
    uint32_t elapsed, total_ms;
    if (!state.clock_synced) { *epoch_s = 0; *ms = 0; return; }
    elapsed = now_ms - g_sync_base_uptime_ms;             /* wrap-safe: unsigned */
    total_ms = (uint32_t)g_sync_base_ms + elapsed;
    *epoch_s = g_sync_base_epoch_s + (int64_t)(total_ms / 1000u);
    *ms = (int64_t)(total_ms % 1000u);
}

/* atom apps/button_clock.clock_set — copied VERBATIM from board/custom/firmware/uno/apps/button_clock.c lines 114-132 (sha256 5931a7efa0004dd5) */
POLARI_NODE(clock_set, in(set_epoch_s, "s", "the host's SET_TIME"), in(set_ms, "ms", "...within the second"),
            in(set_sync_generation, "", "the host's generation counter"), in(now_ms, "ms", "hal_millis() right now"),
            role("record one SET_TIME sync: bump sync_generation, set sync_uncertainty_ms, measure drift_ms from the 2nd sync on"))
static void clock_set(int64_t set_epoch_s, int64_t set_ms, int64_t set_sync_generation, uint32_t now_ms)
{
    if (state.clock_synced) {
        int64_t prev_epoch_s, prev_ms, prev_total_ms, host_total_ms;
        clock_tick(now_ms, &prev_epoch_s, &prev_ms);
        prev_total_ms = prev_epoch_s * 1000 + prev_ms;
        host_total_ms = set_epoch_s * 1000 + set_ms;
        state.drift_ms = prev_total_ms - host_total_ms;    /* measured AT this sync only — never carried/extrapolated */
    }
    g_sync_base_epoch_s = set_epoch_s;
    g_sync_base_ms = (uint16_t)set_ms;
    g_sync_base_uptime_ms = now_ms;
    state.sync_generation = set_sync_generation;
    state.sync_uncertainty_ms = (int64_t)TELEMETRY_MS;     /* the frame period: an honest bound, not a drift model */
    state.clock_synced = 1u;
}

/* atom apps/button_clock.events_queue — copied VERBATIM from board/custom/firmware/uno/apps/button_clock.c lines 136-154 (sha256 5931a7efa0004dd5) */
POLARI_NODE(events_queue, in(kind, "enum", "press | led_on | led_off | sense_rise | sense_fall | sync"),
            in(at_ms, "ms", "device uptime at the moment of the event"),
            role("push one transition into the bounded ring; drop-oldest on overflow, counted in dropped_events"))
static void events_queue(uint8_t kind, uint32_t at_ms)
{
    int64_t es, ms;
    if (g_qcount == EVENT_QUEUE_LEN) {
        g_qtail = (uint8_t)((g_qtail + 1u) % EVENT_QUEUE_LEN);   /* drop-oldest: the oldest queued entry is gone */
        g_qcount--;
        state.dropped_events++;
    }
    clock_tick(at_ms, &es, &ms);
    g_queue[g_qhead].kind = kind;
    g_queue[g_qhead].uptime_ms = at_ms;
    g_queue[g_qhead].epoch_s = (int32_t)es;
    g_queue[g_qhead].ms = (uint16_t)ms;
    g_qhead = (uint8_t)((g_qhead + 1u) % EVENT_QUEUE_LEN);
    g_qcount++;
}

/* atom apps/button_clock.queue_pop — copied VERBATIM from board/custom/firmware/uno/apps/button_clock.c lines 156-163 (sha256 5931a7efa0004dd5) */
static int queue_pop(qevent_t *out)
{
    if (!g_qcount) return 0;
    *out = g_queue[g_qtail];
    g_qtail = (uint8_t)((g_qtail + 1u) % EVENT_QUEUE_LEN);
    g_qcount--;
    return 1;
}

/* atom apps/button_clock.led_toggle — copied VERBATIM from board/custom/firmware/uno/apps/button_clock.c lines 168-185 (sha256 5931a7efa0004dd5) */
POLARI_NODE(led_toggle, uses(LED_PIN), role("on the button atom's toggle-pending flag: flip D6 + D13, stamp led_changed_at, emit events"))
static void led_toggle(uint32_t now_ms)
{
#if HAL_INT0
    int64_t es, ms;
    if (!hal_take_toggle_pending()) return;
    state.button_presses = (int64_t)hal_presses();
    events_queue(BUTTONCLOCKEVENT_KIND_PRESS, now_ms);
    state.led_on = state.led_on ? 0u : 1u;
    hal_led(state.led_on);
    l_led_set(state.led_on);
    clock_tick(now_ms, &es, &ms);
    state.led_changed_at = es;
    events_queue(state.led_on ? BUTTONCLOCKEVENT_KIND_LED_ON : BUTTONCLOCKEVENT_KIND_LED_OFF, now_ms);
#else
    (void)now_ms;
#endif
}

/* atom apps/button_clock.sense_isr — copied VERBATIM from board/custom/firmware/uno/apps/button_clock.c lines 189-211 (sha256 5931a7efa0004dd5) */
POLARI_NODE(sense_isr, uses(SENSE_PIN), role("drain the sense atom's rise/fall counters; emit sense_rise/sense_fall for new edges"))
static void sense_isr(void)
{
#if HAL_INT1
    static uint16_t g_prev_rises, g_prev_falls;
    uint16_t rises, falls, dr, df;
    uint32_t last_ms;
    int64_t es, ms;
    hal_sense_read(&rises, &falls, &last_ms);
    dr = (uint16_t)(rises - g_prev_rises);
    df = (uint16_t)(falls - g_prev_falls);
    if (!dr && !df) return;
    state.sense_rises = rises;
    state.sense_falls = falls;
    clock_tick(last_ms, &es, &ms);
    state.last_edge_at = es;
    state.last_edge_ms = ms;
    while (dr--) events_queue(BUTTONCLOCKEVENT_KIND_SENSE_RISE, last_ms);
    while (df--) events_queue(BUTTONCLOCKEVENT_KIND_SENSE_FALL, last_ms);
    g_prev_rises = rises;
    g_prev_falls = falls;
#endif
}

/* atom apps/button_clock.events_drain — copied VERBATIM from board/custom/firmware/uno/apps/button_clock.c lines 215-233 (sha256 5931a7efa0004dd5) */
static void events_drain(void)
{
    qevent_t e;
    ButtonClockEvent_t ev;
    while (queue_pop(&e)) {
        memset(&ev, 0, sizeof ev);
#if SEND_NAME
        strcpy(ev.name, RIG_NAME);
#endif
        ev.boot_session = state.boot_session;
        ev.kind = e.kind;
        ev.uptime_ms = (int64_t)e.uptime_ms;
        ev.epoch_s = (int64_t)e.epoch_s;
        ev.ms = (int64_t)e.ms;
        ev.seq = (int64_t)g_seq_e;
        hal_usart_send(wire, ButtonClockEvent_frame(wire, DEVICE_ID, g_seq_e, payload, TX_ENCODE_E(&ev, payload, EVENT_TELEMETRY_MASK)));
        g_seq_e++;
    }
}

/* atom apps/button_clock.telemetry_send — copied VERBATIM from board/custom/firmware/uno/apps/button_clock.c lines 239-254 (sha256 5931a7efa0004dd5) */
POLARI_NODE(telemetry_send, in(now_ms, "ms", "hal_millis() right now"),
            role("one ButtonClockState frame (atomic snapshot) then drain events.queue as ButtonClockEvent frames"))
static void telemetry_send(uint32_t now_ms)
{
    ButtonClockState_t snap;
    int64_t es, ms;
    clock_tick(now_ms, &es, &ms);
    state.uptime_ms = (int64_t)now_ms;
    state.epoch_s = es;
    state.ms = ms;
    state.seq = (int64_t)g_seq_s;
    ATOMIC_BLOCK(ATOMIC_RESTORESTATE) { snap = state; }
    hal_usart_send(wire, ButtonClockState_frame(wire, DEVICE_ID, g_seq_s, payload, TX_ENCODE_S(&snap, payload, STATE_TELEMETRY_MASK)));
    g_seq_s++;
    events_drain();
}

/* atom apps/button_clock.apply_command — copied VERBATIM from board/custom/firmware/uno/apps/button_clock.c lines 256-290 (sha256 5931a7efa0004dd5) */
POLARI_NODE(apply_command, in(r, "frame", "a parsed PolariPacket ButtonClockState command"), uses(LED_PIN),
            role("SET_TIME -> clock_set; SET_LED -> the LED, like blink-on-command; SNAPSHOT -> a frame + queue replay now"))
static void apply_command(const polari_rx_t *r)
{
    ButtonClockState_t cmd;
    ButtonClockState_mask_t m;
    uint32_t now_ms = hal_millis();
    if (ButtonClockState_decode_rx(r, &cmd, &m) != 0) return;
    if (m & BUTTONCLOCKSTATE_F_SET_EPOCH_S) {
        int64_t set_ms = (m & BUTTONCLOCKSTATE_F_SET_MS) ? cmd.set_ms : 0;
        int64_t gen = (m & BUTTONCLOCKSTATE_F_SET_SYNC_GENERATION) ? cmd.set_sync_generation : state.sync_generation;
        clock_set(cmd.set_epoch_s, set_ms, gen, now_ms);
        events_queue(BUTTONCLOCKEVENT_KIND_SYNC, now_ms);
        g_status_base = BUTTONCLOCKSTATE_STATUS_SYNCED;
        state.status = g_status_base;
    }
    if (m & BUTTONCLOCKSTATE_F_SET_LED) {
        int64_t es, ms;
        state.led_on = cmd.set_led ? 1u : 0u;
        hal_led(state.led_on);
        l_led_set(state.led_on);
        clock_tick(now_ms, &es, &ms);
        state.led_changed_at = es;
        events_queue(state.led_on ? BUTTONCLOCKEVENT_KIND_LED_ON : BUTTONCLOCKEVENT_KIND_LED_OFF, now_ms);
        if (!(m & BUTTONCLOCKSTATE_F_SET_EPOCH_S)) {
            g_status_base = BUTTONCLOCKSTATE_STATUS_COMMANDED;
            state.status = g_status_base;
        }
    }
    if (m & BUTTONCLOCKSTATE_F_SNAPSHOT) {
        state.status = BUTTONCLOCKSTATE_STATUS_SNAPSHOT;   /* this ONE frame only; telemetry_send sends it right away */
        telemetry_send(now_ms);
        state.status = g_status_base;
    }
}

int main(void)
{
    uint32_t telemetry_next_ms = 0u;

    /* init: the init atoms in graph order, the class identity, then interrupts on */
    pin_config_init();   /* GENERATED (cmod.custom.pin_config_gen) — runs FIRST, before every other init (his fixed order) */
    hal_usart_init();   /* usart_init */
    hal_tick_init();   /* tick_init */
    hal_led_init();   /* led_init */
    l_led_init();   /* l_led_init */
    hal_button_init();   /* button_init */
    hal_sense_init();   /* sense_init */
    const uint32_t boot_session_mint_return = boot_session_mint();   /* boot_session_mint */
    memset(&state, 0, sizeof state);
    memset(&rx, 0, sizeof rx);
state.boot_session = (int64_t)boot_session_mint_return;   /* field uno-button-clock-graph#18 */
    strcpy(state.name, RIG_NAME);
    state.status = BUTTONCLOCKSTATE_STATUS_IDLE;
    sei();

    for (;;) {
        {   /* on-rx uno-button-clock-graph#01: rx_pop → rx; on-command (msg_type BUTTONCLOCKSTATE_MSG_TYPE): apply */
            uint8_t rx_pop_b;
            while (hal_rx_pop(&rx_pop_b))
                if (polari_rx_feed(&rx, rx_pop_b) && rx.msg_type == BUTTONCLOCKSTATE_MSG_TYPE) {
                    apply_command(&rx);   /* apply */
                }
        }
        const uint32_t clock_return = hal_millis();   /* clock */
        led_toggle(clock_return);   /* led_toggle */
        sense_isr();   /* sense_isr */
        if ((int32_t)(clock_return - telemetry_next_ms) >= 0) {   /* tick telemetry: every TELEMETRY_MS ms */
            telemetry_next_ms += TELEMETRY_MS;
            telemetry_send(clock_return);   /* telemetry_send */
        }
    }
}
